## config/west.yml
```yaml
manifest:
  remotes:
    - name: zmkfirmware
      url-base: https://github.com/zmkfirmware
    - name: teinzl
      url-base: https://github.com/teinzl
  projects:
    - name: zmk
      remote: teinzl
      revision: adv360-z3.2-2
      import: app/west.yml
  self:
    path: config
```
